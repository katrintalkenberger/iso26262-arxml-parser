AUTOSAR XML (schema 4-2-1)
package /FaultyArchitecture
  service sw component type NonCompliant_Service_SWC
    behavior Faulty_Behavior
      timing event Orphaned_Timer_Event: period=0.02
      timing event Critical_ZeroTiming_Event: start-on-event=Standard_Runnable, period=0.0
      runnable-entities:
        runnable Standard_Runnable
        runnable Passive_Unused_Runnable
      ar-typed-per-instance-memorys:
        per instance memory Fault_Logger_History_PIM
      shared-parameters:
        parameter data prototype Max_Allowed_Retries_Param
