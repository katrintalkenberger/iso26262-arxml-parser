AUTOSAR XML (schema 4-2-1)
package /VehicleArchitecture
  composition sw component type TopLevel_Composition
    component App_Prototype: type=ValidApp_SWC
    component Cdd_Prototype: type=ValidCdd_SWC
  application sw component type ValidApp_SWC
    behavior ValidApp_Behavior
      timing event Timer_10ms_Event: start-on-event=Cyclic_Runnable, period=0.01
      runnable-entities:
        runnable Cyclic_Runnable
      ar-typed-per-instance-memorys:
        per instance memory Velocity_Filtered_PIM
        per instance memory Acceleration_State_PIM
      shared-parameters:
        parameter data prototype Filter_Gain_Param
  complex device driver sw component type ValidCdd_SWC
    behavior ValidCdd_Behavior
      operation invoked event ClientRequest_Event: start-on-event=Hardware_Runnable
        operation ReadSensorData
      runnable-entities:
        runnable Hardware_Runnable
      ar-typed-per-instance-memorys:
        per instance memory Hardware_Register_Buffer_PIM
      shared-parameters:
        parameter data prototype Sensor_Calibration_Offset_Param
        parameter data prototype SPI_Baudrate_Config_Param
